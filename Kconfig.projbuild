## Kconfig.projbuild
```kconfig
source "components/drivers/lcd_st7262/Kconfig"
source "components/drivers/touch_gt911/Kconfig"
source "components/agents/monitor/Kconfig"
```

## components/agents/monitor/Kconfig
```kconfig
menu "Monitor"

config MONITOR_TEMP_THRESHOLD
    int "Temperature threshold"
    default 30

config MONITOR_HUM_THRESHOLD
    int "Humidity threshold"
    default 80

endmenu
```

## components/drivers/lcd_st7262/Kconfig
```kconfig
menu "ST7262 LCD"

config LCD_ST7262_MOSI
    int "MOSI GPIO"
    default 23

config LCD_ST7262_SCLK
    int "SCLK GPIO"
    default 18

config LCD_ST7262_CS
    int "CS GPIO"
    default 5

config LCD_ST7262_DC
    int "D/C GPIO"
    default 21

config LCD_ST7262_RST
    int "Reset GPIO"
    default 22

endmenu
```

## components/drivers/touch_gt911/Kconfig
```kconfig
menu "GT911 Touch"

config TOUCH_GT911_SDA
    int "SDA GPIO"
    default 21

config TOUCH_GT911_SCL
    int "SCL GPIO"
    default 22

endmenu
```

## sdkconfig.defaults
```kconfig
# Espressif IoT Development Framework (ESP-IDF) Project Configuration

# Target Chip
CONFIG_IDF_TARGET="esp32s3"

# C++ Support
CONFIG_COMPILER_CXX_SUPPORT=y
CONFIG_COMPILER_CXX_EXCEPTIONS=y

# Logging
CONFIG_LOG_DEFAULT_LEVEL_INFO=y
CONFIG_LOG_MAXIMUM_LEVEL=4

# FreeRTOS
CONFIG_FREERTOS_HZ=100

# LVGL
CONFIG_LV_CONF_MINIMAL=n
CONFIG_LV_CONF_SKIP=y
CONFIG_LV_COLOR_DEPTH_16=y
CONFIG_LV_COLOR_16_SWAP=y

# Display
CONFIG_LV_DISP_DEF_REFR_PERIOD=30
CONFIG_LV_DPI_DEF=130

# Memory
CONFIG_ESP32S3_SPIRAM_SUPPORT=y
CONFIG_SPIRAM_MODE_OCT=y
CONFIG_SPIRAM_SPEED_80M=y
```
